## config/west.yml
```yaml
manifest:
  defaults:
    revision: v0.3
  remotes:
    - name: jkorinth
      url-base: https://github.com/jkorinth
    - name: zmkfirmware
      url-base: https://github.com/zmkfirmware
  projects:
    - name: zmk
      remote: jkorinth
      import: app/west.yml
      revision: feature/rgb-underglow-update-hook
    - name: zmk-rgb-underglow-mask-leds
      revision: main
      remote: jkorinth
  self:
    path: config
```
